VERSION "1"

NS_ :

BS_:

BU_: Ecu1 Ecu2

BO_ 1024 Tables8: 8 Ecu1
 SG_ Sa : 0|8@1- (1,0) [-128|127] "" Ecu2
 SG_ Sb : 8|8@1- (1,0) [-128|127] "" Ecu2

BO_ 1025 Big64: 8 Ecu1
 SG_ U64v : 0|64@1+ (1,0) [0|18446744073709551615] "" Ecu2

BO_ 1026 Low64: 8 Ecu1
 SG_ S64v : 0|64@1- (1,0) [-9223372036854775808|9223372036854775807] "" Ecu2

VAL_ 1024 Sa -1 "Minus" 0 "Zero" 127 "Max" ;
VAL_ 1024 Sb 255 "AllOnes" 0 "Zero" ;
VAL_ 1025 U64v 18446744073709551615 "Full" 0 "Empty" ;
VAL_ 1026 S64v -9223372036854775808 "Lowest" 9223372036854775807 "Highest" ;
