VERSION "1"

NS_ :

BS_:

BU_: Good Bad-Node

BO_ 100 9Msg: 8 Good
 SG_ Bad-Sig : 0|8@1+ (1,0) [0|255] "" Bad-Node
