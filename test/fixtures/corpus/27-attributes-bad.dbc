VERSION "1"

NS_ :

BS_:

BU_: A B

BO_ 100 M: 8 A
 SG_ S : 0|8@1+ (1,0) [0|255] "" B

BA_DEF_ BO_ "Prio" INT 0 7;
BA_DEF_ BO_ "Prio" INT 0 7;
BA_DEF_ SG_ "Gain" FLOAT 0 10;
BA_DEF_ "Mode" ENUM "A","B";
BA_DEF_ "Label" STRING ;
BA_DEF_ BO_ "Mask" HEX 0 255;
BA_DEF_DEF_ "Prio" 0;
BA_DEF_DEF_ "Ghost" 5;
BA_DEF_DEF_ "Mode" "C";
BA_ "Prio" BO_ 100 9;
BA_ "Prio" BO_ 999 3;
BA_ "Gain" SG_ 100 S 11.5;
BA_ "Gain" BO_ 100 1;
BA_ "Unknown" 5;
BA_ "Label" 5;
BA_ "Mask" BO_ 100 1.5;
