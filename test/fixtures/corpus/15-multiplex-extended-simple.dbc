VERSION "1"

NS_ :

BS_:

BU_: Ecu1 Ecu2

BO_ 1102 MuxRanges: 8 Ecu1
 SG_ Sel M : 0|8@1+ (1,0) [0|255] "" Ecu2
 SG_ A m0 : 8|8@1+ (1,0) [0|255] "" Ecu2
 SG_ B m5 : 16|8@1+ (1,0) [0|255] "" Ecu2
 SG_ C m9 : 8|8@1+ (1,0) [0|255] "" Ecu2

SG_MUL_VAL_ 1102 A Sel 0-3;
SG_MUL_VAL_ 1102 B Sel 5-5, 7-9;
SG_MUL_VAL_ 1102 C Sel 9-12;
