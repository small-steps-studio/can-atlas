VERSION "1"

NS_ :

BS_:

BU_: Ecu1 Ecu2

BO_ 1200 Dlc0: 0 Ecu1

BO_ 1201 Dlc8: 8 Ecu1
 SG_ D8 : 0|64@1+ (1,0) [0|18446744073709551615] "" Ecu2

BO_ 1202 Dlc12: 12 Ecu1
 SG_ H0 : 0|8@1+ (1,0) [0|255] "" Ecu2
 SG_ H1 : 88|8@1+ (1,0) [0|255] "" Ecu2

BO_ 1203 Dlc24: 24 Ecu1
 SG_ U0 : 184|8@1+ (1,0) [0|255] "" Ecu2

BO_ 1204 Dlc64: 64 Ecu1
 SG_ Z0 : 504|8@1+ (1,0) [0|255] "" Ecu2
 SG_ Z1 : 255|16@0+ (1,0) [0|65535] "" Ecu2

BO_ 1205 Dlc9: 9 Ecu1
 SG_ Y : 0|8@1+ (1,0) [0|255] "" Ecu2

BO_ 1206 Dlc65: 65 Ecu1
 SG_ X : 0|8@1+ (1,0) [0|255] "" Ecu2
