VERSION "1"

NS_ :

BS_:

BU_: Ecu1 Ecu2

BO_ 1105 MuxAmbig: 8 Ecu1
 SG_ Sel1 M : 0|4@1+ (1,0) [0|15] "" Ecu2
 SG_ Sel2 M : 4|4@1+ (1,0) [0|15] "" Ecu2
 SG_ Data m0 : 8|8@1+ (1,0) [0|255] "" Ecu2
