VERSION "1"

NS_ :

BS_:

BU_: Ecu1 Ecu2

BO_ 1101 MuxEight: 8 Ecu1
 SG_ Sel M : 0|3@1+ (1,0) [0|7] "" Ecu2
 SG_ V0 m0 : 8|8@1+ (1,0) [0|255] "" Ecu2
 SG_ V1 m1 : 8|8@1+ (1,0) [0|255] "" Ecu2
 SG_ V2 m2 : 8|8@1+ (1,0) [0|255] "" Ecu2
 SG_ V3 m3 : 8|8@1+ (1,0) [0|255] "" Ecu2
 SG_ V4 m4 : 8|8@1+ (1,0) [0|255] "" Ecu2
 SG_ V5 m5 : 8|8@1+ (1,0) [0|255] "" Ecu2
 SG_ V6 m6 : 8|8@1+ (1,0) [0|255] "" Ecu2
 SG_ V7 m7 : 8|8@1+ (1,0) [0|255] "" Ecu2
