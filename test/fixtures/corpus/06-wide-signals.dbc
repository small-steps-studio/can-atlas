VERSION "1"

NS_ :

BS_:

BU_: Ecu1 Ecu2

BO_ 1024 Wide64: 8 Ecu1
 SG_ U64 : 0|64@1+ (1,0) [0|18446744073709551615] "" Ecu2

BO_ 1025 WideMotS: 8 Ecu1
 SG_ M64S : 7|64@0- (1,0) [-9223372036854775808|9223372036854775807] "" Ecu2

BO_ 1026 Wide63: 8 Ecu1
 SG_ L63 : 1|63@1+ (1,0) [0|9223372036854775807] "" Ecu2

BO_ 1027 Wide63M: 8 Ecu1
 SG_ N63 : 6|63@0+ (1,0) [0|9223372036854775807] "" Ecu2

BO_ 1028 WideDec: 8 Ecu1
 SG_ D64 : 0|64@1+ (0.001,0) [0|18446744073709551.615] "km" Ecu2

BO_ 1029 WideS64: 8 Ecu1
 SG_ S64 : 0|64@1- (1,0) [-9223372036854775808|9223372036854775807] "" Ecu2
