VERSION "1"

NS_ :

BS_:

BU_: Ecu1 Ecu2

BO_ 1107 MuxLoop: 8 Ecu1
 SG_ A m0M : 0|4@1+ (1,0) [0|15] "" Ecu2
 SG_ B m0M : 4|4@1+ (1,0) [0|15] "" Ecu2
 SG_ C m0 : 8|8@1+ (1,0) [0|255] "" Ecu2

SG_MUL_VAL_ 1107 A B 0-0;
SG_MUL_VAL_ 1107 B A 0-0;
SG_MUL_VAL_ 1107 C A 0-0;
