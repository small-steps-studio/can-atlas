VERSION "1"

NS_ :

BS_:

BU_: A B

BO_ 100 M1: 8 A
 SG_ S1 : 0|8@1+ (1,0) [0|255] "" B
 SG_ S2 : 8|8@1+ (1,0) [0|255] "" B

BO_ 101 M2: 8 B
 SG_ S3 : 0|8@1+ (1,0) [0|255] "" A

BA_DEF_ "BusType" STRING ;
BA_DEF_ BU_ "NodeRole" STRING ;
BA_DEF_ BO_ "GenMsgCycleTime" INT 0 65535;
BA_DEF_ BO_ "MaskBits" HEX 0 255;
BA_DEF_ SG_ "SigGain" FLOAT 0 10;
BA_DEF_ SG_ "SigClass" ENUM "None","Slow","Fast";
BA_DEF_ "Generation" INT 1 9;
BA_DEF_DEF_ "BusType" "";
BA_DEF_DEF_ "NodeRole" "";
BA_DEF_DEF_ "GenMsgCycleTime" 0;
BA_DEF_DEF_ "MaskBits" 0;
BA_DEF_DEF_ "SigGain" 1;
BA_DEF_DEF_ "SigClass" "None";
BA_DEF_DEF_ "Generation" 1;
BA_ "BusType" "CAN";
BA_ "Generation" 3;
BA_ "NodeRole" BU_ A "master";
BA_ "GenMsgCycleTime" BO_ 100 10;
BA_ "MaskBits" BO_ 100 16;
BA_ "SigGain" SG_ 100 S1 2.5;
BA_ "SigClass" SG_ 100 S1 2;
BA_ "SigClass" SG_ 100 S2 "Fast";
