VERSION "1"

NS_ :

BS_:

BU_: A B

BO_ 100 M: 8 A
 SG_ S : 0|8@1+ (1,0) [0|255] "" B

VAL_ 999 S 1 "x" ;
VAL_ 100 Nope 1 "x" ;
CM_ BO_ 999 "c";
CM_ SG_ 100 Nope "c";
CM_ BU_ Ghost "c";
SG_MUL_VAL_ 999 S Sel 0-0;
SG_MUL_VAL_ 100 Nope Sel 0-0;
SIG_VALTYPE_ 999 S : 1;
