VERSION "1"

NS_ :

BS_:

BU_: Ecu1 Ecu2

BO_ 1104 MuxThree: 8 Ecu1
 SG_ M0 M : 0|2@1+ (1,0) [0|3] "" Ecu2
 SG_ M1 m1M : 2|2@1+ (1,0) [0|3] "" Ecu2
 SG_ M2 m2M : 4|2@1+ (1,0) [0|3] "" Ecu2
 SG_ S m3 : 8|8@1+ (1,0) [0|255] "" Ecu2
 SG_ T m0 : 16|8@1+ (1,0) [0|255] "" Ecu2

SG_MUL_VAL_ 1104 M1 M0 1-1;
SG_MUL_VAL_ 1104 M2 M1 2-2;
SG_MUL_VAL_ 1104 S M2 3-3;
SG_MUL_VAL_ 1104 T M0 0-0;
