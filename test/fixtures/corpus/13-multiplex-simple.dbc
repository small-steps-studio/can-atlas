VERSION "1"

NS_ :

BS_:

BU_: Ecu1 Ecu2

BO_ 1100 MuxSimple: 8 Ecu1
 SG_ Sel M : 0|8@1+ (1,0) [0|255] "" Ecu2
 SG_ A m0 : 8|16@1+ (1,0) [0|65535] "" Ecu2
 SG_ B m1 : 8|16@1+ (0.1,0) [0|6553.5] "" Ecu2
 SG_ C m0 : 24|8@1+ (1,0) [0|255] "" Ecu2
 SG_ D : 56|8@1+ (1,0) [0|255] "" Ecu2
