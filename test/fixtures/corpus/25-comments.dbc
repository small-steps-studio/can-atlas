VERSION "1"

NS_ :

BS_:

BU_: A B

BO_ 100 M1: 8 A
 SG_ S1 : 0|8@1+ (1,0) [0|255] "" B
 SG_ S2 : 8|8@1+ (1,0) [0|255] "" B

BO_ 101 M2: 4 B
 SG_ S3 : 0|8@1+ (1,0) [0|255] "" A

CM_ "Network comment.";
CM_ BU_ A "Node comment.";
CM_ BO_ 100 "Message comment.";
CM_ SG_ 100 S1 "Signal with \"quotes\" and a ; semicolon and a back\\slash.";
CM_ SG_ 100 S2 "line one
line two
line three;";
