VERSION "1"

NS_ :

BS_:

BU_: A B

BO_ 100 M1: 8 A
 SG_ S1 : 0|8@1+ (1,0) [0|255] "" B

BO_ 101 M2: 8 Vector__XXX
 SG_ S2 : 0|8@1+ (1,0) [0|255] "" Vector__XXX

BO_TX_BU_ 100 : B;
BO_TX_BU_ 999 : A;
BO_TX_BU_ 100 : Ghost;
