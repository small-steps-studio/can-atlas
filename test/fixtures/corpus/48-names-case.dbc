VERSION "1"

NS_ :

BS_:

BU_: Gateway gateway

BO_ 100 Speed: 8 Gateway
 SG_ Rpm : 0|8@1+ (1,0) [0|255] "" gateway
 SG_ rpm : 8|8@1+ (1,0) [0|255] "" gateway

BO_ 101 SPEED: 8 gateway
 SG_ S : 0|8@1+ (1,0) [0|255] "" Gateway
