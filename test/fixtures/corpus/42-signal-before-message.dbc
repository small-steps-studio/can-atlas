BU_: A B
 SG_ Lost : 0|8@1+ (1,0) [0|255] "" B
BO_ 100 M: 8 A
 SG_ Ok : 0|8@1+ (1,0) [0|255] "" B
CM_ "x";
 SG_ Lost2 : 8|8@1+ (1,0) [0|255] "" B
