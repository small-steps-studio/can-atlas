VERSION "1"

NS_ :

BS_:

BU_: Ecu1 Ecu2

BO_ 1800 FloatScaled32: 8 Ecu1
 SG_ G32 : 0|32@1+ (2,1) [0|0] "" Ecu2

BO_ 1801 FloatScaled64: 8 Ecu1
 SG_ H64 : 0|64@1+ (0.5,-0.25) [0|0] "" Ecu2

SIG_VALTYPE_ 1800 G32 : 1;
SIG_VALTYPE_ 1801 H64 : 2;
