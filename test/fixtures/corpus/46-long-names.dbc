VERSION "1"

NS_ :

BS_:

BU_: LongNodeNameWithFortyCharacters_abcdefgh Short

BO_ 100 LongMessageNameWith33Characters_x: 8 LongNodeNameWithFortyCharacters_abcdefgh
 SG_ SignalNameThatIsSixtyFourCharactersLongBecauseItRepeatsABlockxxx : 0|8@1+ (1,0) [0|255] "" Short

BO_ 101 ExactlyThirtyTwoCharactersLong_x: 8 Short
 SG_ Ok : 0|8@1+ (1,0) [0|255] "" LongNodeNameWithFortyCharacters_abcdefgh
