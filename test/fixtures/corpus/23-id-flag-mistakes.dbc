VERSION "1"

NS_ :

BS_:

BU_: Ecu1 Ecu2

BO_ 2048 FlagMissing: 8 Ecu1
 SG_ A : 0|8@1+ (1,0) [0|255] "" Ecu2

BO_ 2684354560 TooBig: 8 Ecu1
 SG_ B : 0|8@1+ (1,0) [0|255] "" Ecu2

BO_ 4294967296 Huge: 8 Ecu1
 SG_ C : 0|8@1+ (1,0) [0|255] "" Ecu2

BO_ 2147483649 ExtButStd: 8 Ecu1
 SG_ D : 0|8@1+ (1,0) [0|255] "" Ecu2

BO_ 3 StdButExt: 8 Ecu1
 SG_ E : 0|8@1+ (1,0) [0|255] "" Ecu2

BO_ 2047 Edge: 8 Ecu1
 SG_ F : 0|8@1+ (1,0) [0|255] "" Ecu2

BO_ 2147485695 ExtEdge: 8 Ecu1
 SG_ G : 0|8@1+ (1,0) [0|255] "" Ecu2

BA_DEF_ BO_ "VFrameFormat" ENUM "StandardCAN","ExtendedCAN";
BA_DEF_DEF_ "VFrameFormat" "StandardCAN";
BA_ "VFrameFormat" BO_ 3 1;
