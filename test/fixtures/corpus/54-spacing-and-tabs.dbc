VERSION	"1"

BU_:	A	B   C

BO_	100	M1:	8	A
SG_ S1 :0|8@1+	( 1 , 0 )	[ 0 | 255 ]	""	B , C

   SG_  S2  :  8|8@0+  (1,0)  [0|255]  "x"  C

BO_ 101  M2 :  2   B
 SG_ S3 : 0|16@1- (0.5,0) [-16384|16383.5] "u" A
