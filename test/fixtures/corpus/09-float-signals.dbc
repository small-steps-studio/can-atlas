VERSION "1"

NS_ :

BS_:

BU_: Ecu1 Ecu2

BO_ 1792 Float32: 8 Ecu1
 SG_ FA : 0|32@1+ (1,0) [-1000|1000] "" Ecu2
 SG_ FB : 32|32@1+ (1,0) [-1000|1000] "" Ecu2

BO_ 1793 Float64: 8 Ecu1
 SG_ FD : 0|64@1+ (1,0) [-1000|1000] "" Ecu2

BO_ 1794 FloatMot: 8 Ecu1
 SG_ FM : 7|32@0+ (1,0) [-1000|1000] "" Ecu2
 SG_ FM2 : 39|32@0+ (1,0) [-1000|1000] "" Ecu2

SIG_VALTYPE_ 1792 FA : 1;
SIG_VALTYPE_ 1792 FB : 1;
SIG_VALTYPE_ 1793 FD : 2;
SIG_VALTYPE_ 1794 FM : 1;
SIG_VALTYPE_ 1794 FM2 : 1;
