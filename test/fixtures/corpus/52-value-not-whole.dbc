VERSION "1"

NS_ :

BS_:

BU_: A B

BO_ 100 M: 8 A
 SG_ S : 0|8@1+ (1,0) [0|255] "" B

VAL_ 100 S 1.5 "half" 2 "two" ;
