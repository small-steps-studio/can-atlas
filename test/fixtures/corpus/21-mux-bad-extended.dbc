VERSION "1"

NS_ :

BS_:

BU_: Ecu1 Ecu2

BO_ 1 MxA: 8 Ecu1
 SG_ Sel M : 0|4@1+ (1,0) [0|15] "" Ecu2
 SG_ P m0 : 8|8@1+ (1,0) [0|255] "" Ecu2

BO_ 2 MxB: 8 Ecu1
 SG_ Sel M : 0|4@1+ (1,0) [0|15] "" Ecu2
 SG_ Q m3 : 8|8@1+ (1,0) [0|255] "" Ecu2

BO_ 3 MxC: 8 Ecu1
 SG_ Sel M : 0|4@1+ (1,0) [0|15] "" Ecu2
 SG_ R m3 : 8|8@1+ (1,0) [0|255] "" Ecu2

BO_ 4 MxD: 8 Ecu1
 SG_ Sel M : 0|4@1+ (1,0) [0|15] "" Ecu2
 SG_ T m1 : 8|8@1+ (1,0) [0|255] "" Ecu2

BO_ 5 MxE: 8 Ecu1
 SG_ U : 0|8@1+ (1,0) [0|255] "" Ecu2
 SG_ Sel2 M : 8|4@1+ (1,0) [0|15] "" Ecu2

BO_ 6 MxF: 8 Ecu1
 SG_ V m2 : 0|8@1+ (1,0) [0|255] "" Ecu2

BO_ 7 MxG: 8 Ecu1
 SG_ Sel M : 0|2@1+ (1,0) [0|3] "" Ecu2
 SG_ W m9 : 8|8@1+ (1,0) [0|255] "" Ecu2

SG_MUL_VAL_ 1 P Nope 0-0;
SG_MUL_VAL_ 2 Q Sel 5-4;
SG_MUL_VAL_ 3 R Sel 5-6;
SG_MUL_VAL_ 4 T Sel 1-1;
SG_MUL_VAL_ 4 T Sel 2-2;
SG_MUL_VAL_ 5 U Sel2 0-0;
