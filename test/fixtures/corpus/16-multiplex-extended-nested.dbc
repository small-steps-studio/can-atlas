VERSION "1"

NS_ :

BS_:

BU_: Ecu1 Ecu2

BO_ 1103 MuxNested: 8 Ecu1
 SG_ Sel M : 0|4@1+ (1,0) [0|15] "" Ecu2
 SG_ Sub m1M : 4|4@1+ (1,0) [0|15] "" Ecu2
 SG_ X m0 : 8|8@1+ (1,0) [0|255] "" Ecu2
 SG_ Y m1 : 8|8@1+ (1,0) [0|255] "" Ecu2
 SG_ Z m0 : 16|8@1+ (1,0) [0|255] "" Ecu2
 SG_ W m2 : 24|8@1+ (1,0) [0|255] "" Ecu2

SG_MUL_VAL_ 1103 X Sel 0-0;
SG_MUL_VAL_ 1103 Y Sel 1-1;
SG_MUL_VAL_ 1103 Z Sub 0-3;
SG_MUL_VAL_ 1103 W Sub 2-2;
