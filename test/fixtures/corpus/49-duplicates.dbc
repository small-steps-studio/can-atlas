VERSION "1"

NS_ :

BS_:

BU_: A B A

BO_ 100 M1: 8 A
 SG_ S : 0|8@1+ (1,0) [0|255] "" B
 SG_ S : 8|8@1+ (1,0) [0|255] "" B

BO_ 100 M2: 8 Zed
 SG_ T : 0|8@1+ (1,0) [0|255] "" Ghost

BO_ 101 M1: 8 A
 SG_ U : 0|8@1+ (1,0) [0|255] "" B
