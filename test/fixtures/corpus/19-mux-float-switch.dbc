VERSION "1"

NS_ :

BS_:

BU_: Ecu1 Ecu2

BO_ 1106 MuxFloat: 8 Ecu1
 SG_ Sel M : 0|32@1+ (1,0) [0|0] "" Ecu2
 SG_ A m0 : 32|8@1+ (1,0) [0|255] "" Ecu2

SIG_VALTYPE_ 1106 Sel : 1;
