VERSION "1"

BU_: A B

BO_ 100 Msg: 8 A
 SG_ S : 0|8@1+ (1,0) [0|255] "" B
