VERSION "1"

NS_ :

BS_:

BU_: A B

BO_ 3221225472 VECTOR__INDEPENDENT_SIG_MSG: 0 Vector__XXX
 SG_ Free1 : 0|8@1+ (1,0) [0|255] "" B
 SG_ Free2 : 8|8@1+ (1,0) [0|255] "" B

BO_ 100 M: 8 A
 SG_ S : 0|8@1+ (1,0) [0|255] "" B
