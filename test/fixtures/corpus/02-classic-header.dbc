VERSION "1.0"

NS_ :

BS_:

BU_: Engine Gearbox Cluster

VAL_TABLE_ OnOff 1 "On" 0 "Off" ;

BO_ 100 Status: 8 Engine
 SG_ Running : 0|1@1+ (1,0) [0|1] "" Cluster
 SG_ Gear : 8|4@1+ (1,0) [0|15] "" Cluster,Gearbox

BO_ 101 Request: 2 Cluster
 SG_ ReqGear : 0|4@1+ (1,0) [0|15] "" Gearbox

CM_ "Invented test network.";
CM_ BU_ Engine "Drives the powertrain.";
CM_ BO_ 100 "Status of the drive.";
CM_ SG_ 100 Gear "Selected gear.";
VAL_ 100 Running 1 "On" 0 "Off" ;
